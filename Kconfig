## Kconfig
```kconfig
mainmenu "WorkhorseRT Configuration"

# Board specific configs

config KARCH_HAS_PER_CPU_TIMERS
    bool

# Kernel configs

choice 

    prompt "Architecture"
    default ARCH_X86_64

    config ARCH_X86_64
        bool "x86_64"

endchoice # Architecture

if ARCH_X86_64
    source "arch/x86_64/Kconfig"
endif # ARCH_X86_64

config KMAX_CPUS
    int "Maximum number of CPUs"
    default 4
    range 1 512
    ---help---
        Sets the maximum number of CPUs supported by WorkhorseRT

config KBUF_SIZE
    int "Kernel buffer size"
    default 256
    range 256 4096
    ---help---
        Size of stack buffers used in the kernel

choice

    prompt "Scheduling algorithm"
    default KSCHED_ALGORITHM_BCS

    config KSCHED_ALGORITHM_BCS
        bool "Burst-cooldown server"

    config KSCHED_ALGORITHM_DS
        bool "Deferrable server"

endchoice # Scheduling algorithm

choice 

    prompt "Scheduling policy"
    default KSCHED_POLICY_RR

    config KSCHED_POLICY_RR
        bool "Round robin"

    config KSCHED_POLICY_CYCLIC
        bool "Cyclic"

    config KSCHED_POLICY_EDF
        bool "Earliest deadline first"

endchoice # Scheduling policy

if KSCHED_POLICY_RR

    config KSCHED_POLICY_RR_NUM_PRIO
        int "Number of priorities"
        default 32
        range 1 256
        ---help---
            Number of valid priority levels with round robin scheduling

endif # KSCHED_POLICY_RR 

if KSCHED_POLICY_CYCLIC

    config KSCHED_POLICY_CYCLIC_NUM_FRAMES
        int "Number of frames"
        default 256
        range 1 8192
        ---help---
            Number of valid scheduling frames with cyclic scheduling

endif # KSCHED_POLICY_CYCLIC

config KMAX_TASKS
    int "Maximum number of tasks"
    default 256
    range 1 8192
    ---help---
        Sets the maximum number of tasks

config KMAX_DOMAINS
    int "Maximum number of domains"
    default 256
    range 1 8192
    ---help---
        Sets the maximum number of domains

config KMAX_DOMAIN_INVOCATION_DEPTH
    int "Maximum domain invocation depth"
    default 8
    range 1 256
    ---help---
        Sets the maximum number of nested domain invocations possible

config KDYNAMIC_ASSERT
    bool "Enable dynamic asserts"
    default y
    ---help---
        Enables dynamic assertations for debugging purposes

config KTICK_MS
    int "Time taken between each tick (ms)"
    default 1
    range 1 2147483647
    ---help---
        Sets the number of milliseconds taken between each tick

config KSYS_GET_CPU_ID
    bool "WORKHORSE_SYS_GET_CPU_ID"
    default y
    ---help---
        Enables the WORKHORSE_SYS_GET_CPU_ID syscall

config KPLUGIN_DEMO
    bool "Plugin demo"
    default n
    ---help---
        Enables the demo for plugins

# Kernel configs based on board specific configs

config KTICK_DESYNCHRONIZED
    bool "Desynchronized scheduling"
    depends on KARCH_HAS_PER_CPU_TIMERS
    default n
    ---help---
        Have every core use their own tick timer
```

## arch/ia32e/Kconfig
```kconfig
menu "ia32e Configuration"

# CMake configs

config CMAKELISTS_SUBDIR
    string 
    default "arch/ia32e"

# Kernel configs

config IA32E_KSTACK_SIZE
    int "Kernel stack size"
    default 4096
    range 4096 65536
    ---help---
        Size of each kernel stack in bytes.
        
config IA32E_KMAX_SIZE_MB
    int "Maximum kernel size (MB)"
    default 4
    range 2 512

config IA32E_MULTIBOOT2
    bool "Multiboot2"
    default y
    ---help---
        Enable support for booting as a multiboot2 module

config IA32E_MAX_VMA_PARTITIONS
    int "Maximum number of vma partitions"
    range 1 511
    ---help---
        Sets the maximum number of vma partitions supported by WorkhorseRT
        on the ia32e architecture

config IA32E_VMA_EARLY_PARTITION_TABLE_COUNT
    int "Number of vma partitions used by early vma"
    range 1 511
    ---help---
        Sets the number of vma partitions used by WorkhorseRT early vma
        on the ia32e architecture

config IA32E_MAX_IOAPICS
    int "Maximum number of IOAPICs"
    default 2
    range 1 32
    ---help---
        Sets the maximum number of IOAPICs supported by WorkhorseRT
        on the ia32e architecture

config IA32E_APPLY_MADT_NMI_OVERRIDES
    bool "Apply MADT NMI overrides"
    default n
    ---help---
        "Enable NMI overrides stated by the ACPI MADT"

config IA32E_APIC_CALIBRATION_TIME_MS
    int "Apic calibration time ms"
    default 1
    range 1 10
    ---help---
        "Amount of time taken to calibrate the Apic"

config IA32E_FEATURE_PCID
    bool "Enable PCID"
    default y
    ---help---
        "Enable PCID if supported"

config IA32E_FEATURE_UMIP
    bool "Enable UMIP"
    default y
    ---help---
        "Enable UMIP if supported"

endmenu
```

## arch/mips32/Kconfig
```kconfig
menu "mips32 Configuration"

# CMake configs

config CMAKELISTS_SUBDIR
    string 
    default "arch/mips32/bsp/malta"

# Kernel configs

choice 

    prompt "Board"
    default MIPS32_BOARD_MALTA

    config MIPS32_BOARD_MALTA
        bool "malta"

endchoice # Board

if MIPS32_BOARD_MALTA
    source "arch/mips32/bsp/malta/Kconfig"
endif

endmenu
```

## arch/mips32/bsp/malta/Kconfig
```kconfig
menu "mips32/malta Configuration"

choice 

    prompt "Endianness"
    default MIPS32_MALTA_BE

    config MIPS32_MALTA_BE
        bool "Big endian"

    config MIPS32_MALTA_LE
        bool "Little endian"

endchoice # Endianness

config MIPS32_CMAKELISTS_SUBDIR
    string
    default "bsp/malta"

if MIPS32_MALTA_BE

config CMAKE_TOOLCHAIN
    string
    default "arch/mips32/bsp/malta/toolchainBe.cmake"

endif # MIPS32_MALTA_BE 

if MIPS32_MALTA_LE

config CMAKE_TOOLCHAIN
    string
    default "arch/mips32/bsp/malta/toolchainLe.cmake"

endif # MIPS32_MALTA_LE 

config MIPS32_MALTA_KMAX_SIZE_MB
    int "Maximum kernel size (MB)"
    default 1
    range 1 512

config MIPS32_MALTA_FPU
    bool "FPU"
    default y
    ---help---
        Enables the floating point unit

config MIPS32_MALTA_FR
    bool "FR"
    depends on MIPS32_MALTA_FPU
    default n
    ---help---
        Enables floating point register mode

config MIPS32_MALTA_DSP
    bool "DSP"
    default y
    ---help---
        Enables digital signal processing extension

config MIPS32_MALTA_MSA
    bool "MSA"
    default y
    ---help---
        Enables MIPS SIMD architecture extension

config MIPS32_MALTA_ASID
    bool "asid"
    default y
    ---help---
        Enables ASIDs

config MIPS32_MALTA_ASID_WIDTH
    int "asid width"
    depends on MIPS32_MALTA_ASID
    default 8
    range 1 8
    ---help---
        Sets the max asid width supported by the cpu (WARNING: this can lead to issues if incorrectly set)

config MIPS32_MALTA_AE
    bool "asid extension"
    default y
    depends on MIPS32_MALTA_ASID
    ---help---
        Enables ASID extension if supported

config MIPS32_MALTA_KSTACK_SIZE
    int "Kernel stack size"
    default 2048
    range 2048 65536
    ---help---
        Size of each kernel stack in bytes.

endmenu
```

## arch/x86_64/Kconfig
```kconfig
menu "x86_64 configuration"

# Kernel configs

choice 

    prompt "Bsp"
    default ARCH_X86_64_IA32E

    config ARCH_X86_64_IA32E
        bool "ia32e"

endchoice # Bsp


# CMake configs

if ARCH_X86_64_IA32E

config CMAKELISTS_SUBDIR
    string 
    default "arch/x86_64/ia32e"

source "arch/x86_64/ia32e/Kconfig"

endif

config CMAKE_TOOLCHAIN
    string 
    default "arch/x86_64/toolchain.cmake"

endmenu
```

## arch/x86_64/ia32e/Kconfig
```kconfig
menu "ia32e Configuration"

# Board specific configs

config KARCH_HAS_PER_CPU_TIMERS
    default y    

# Kernel configs

config X86_64_IA32E_VTX
    bool "Vtx"
    default y
    ---help---
        Enable hardware assisted virtualization

config X86_64_IA32E_VTX_FEATURE_VPID
    bool "Vpid"
    depends on X86_64_IA32E_VTX
    default y
    ---help---
        Enable vpids if supported

config X86_64_IA32E_VTX_TSC_CALIBRATION_TIME_MS
    int "Tsc calibration time ms"
    depends on X86_64_IA32E_VTX
    default 1
    range 1 10
    ---help---
        Amount of time taken to calibrate the tsc

config X86_64_IA32E_VTX_TSD
    bool "Disable TSC in vtx"
    depends on X86_64_IA32E_VTX
    default n
    ---help---
        Disable timestamp counter in virtual domains

config X86_64_IA32E_VTX_ACCESS_DENIED_GP0
    bool "GP0 on denied access to resources in vtx"
    depends on X86_64_IA32E_VTX
    default n
    ---help---
        Inject GP0 when a guest attempt to access a resource is denied instead of failing the vcpu

config X86_64_IA32E_KSTACK_SIZE
    int "Kernel stack size"
    default 4096
    range 4096 65536
    ---help---
        Size of each kernel stack in bytes.
        
config X86_64_IA32E_KMAX_SIZE_MB
    int "Maximum kernel size (MB)"
    default 4
    range 2 512

config X86_64_IA32E_MULTIBOOT2
    bool "Multiboot2"
    default y
    ---help---
        Enable support for booting as a multiboot2 module

config X86_64_IA32E_MAX_VMA_PARTITIONS
    int "Maximum number of vma partitions"
    default 1
    range 1 511
    ---help---
        Sets the maximum number of vma partitions supported by WorkhorseRT
        on the ia32e architecture

config X86_64_IA32E_VMA_EARLY_PARTITION_TABLE_COUNT
    int "Number of vma partitions used by early vma"
    default 1
    range 1 511
    ---help---
        Sets the number of vma partitions used by WorkhorseRT early vma
        on the ia32e architecture

config X86_64_IA32E_MAX_IOAPICS
    int "Maximum number of IOAPICs"
    default 2
    range 1 32
    ---help---
        Sets the maximum number of IOAPICs supported by WorkhorseRT
        on the ia32e architecture

config X86_64_IA32E_APPLY_MADT_NMI_OVERRIDES
    bool "Apply MADT NMI overrides"
    default n
    ---help---
        Enable NMI overrides stated by the ACPI MADT

config X86_64_IA32E_APIC_CALIBRATION_TIME_MS
    int "Apic calibration time ms"
    default 1
    range 1 10
    ---help---
        Amount of time taken to calibrate the Apic

config X86_64_IA32E_FEATURE_PCID
    bool "Enable PCID"
    default y
    ---help---
        Enable PCID if supported

config X86_64_IA32E_FEATURE_UMIP
    bool "Enable UMIP"
    default y
    ---help---
        Enable UMIP if supported

config X86_64_IA32E_FEATURE_SMEP
    bool "Enable SMEP"
    default n
    ---help---
        "Enable SMEP if supported

config X86_64_IA32E_FEATURE_SMAP
    bool "Enable SMAP"
    default n
    ---help---
        "Enable SMAP if supported

config X86_64_IA32E_TSD
    bool "Disable TSC"
    default n
    ---help---
        Disable timestamp counter in native domains

endmenu
```
